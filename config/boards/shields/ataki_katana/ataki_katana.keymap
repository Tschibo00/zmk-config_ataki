#define ZMK_POINTING_DEFAULT_SCRL_VAL 100

#include <behaviors.dtsi>
#include <dt-bindings/zmk/keys.h>
#include <dt-bindings/zmk/bt.h>
#include <dt-bindings/zmk/pointing.h>
#include <input/processors.dtsi>
#include "../../../inc/helpers.h"

// Layers
#define BASE 0
#define NUMSYM 1
#define NAVFN 2
#define SYSTEM 3
#define CMD 4
#define BASE_LAYERS BASE

#define MC_ONESHOT 5
#define MC_M       6
#define MC_S       7
#define MC_N       8
#define MC_T       9
#define MC_E       10
#define MC_P       11
#define MC_X       12

#define toM &sl MC_M
#define toS &sl MC_S
#define toN &sl MC_N
#define toT &sl MC_T
#define toE &sl MC_E
#define toP &sl MC_P
#define toX &sl MC_X

#define ___ &trans

/* How quickly Combo keys must be pressed together */
#define COMBO_TIMEOUT_MS 30
/* Macro timers; can be increased for systems that don't like 0ms Macros */
#define FAST_MACRO_TAP_MS 30
#define FAST_MACRO_WAIT_MS 30

/* Custom base layer punctuation */
SHIFT_MORPH(comma_qust, &kp COMMA, &kp QMARK)
SHIFT_MORPH(dot_exc, &kp DOT, &kp EXCL)
SHIFT_MORPH(eql_bksl, &kp EQUAL, &kp BSLH)
SHIFT_MORPH(star_pipe, &kp STAR, &kp PIPE)
SHIFT_MORPH(plus_slsh, &kp PLUS, &kp FSLH)

MY_HOLD_TAP(dot_morph, &dot_exc, &kp)
MY_HOLD_TAP(comma_morph, &comma_qust, &kp)
MY_HOLD_TAP(apos_morph, &mc_apos, &kp)

&msc {
    acceleration-exponent = <0>;
    time-to-max-speed-ms = <300>;
    delay-ms = <0>;
};

/ {
    behaviors {
       ht: hold_tap {
            compatible = "zmk,behavior-hold-tap";
            #binding-cells = <2>;
            flavor = "balanced";
            tapping-term-ms = <300>;
            require-prior-idle-ms = <100>;
            bindings = <&kp>, <&kp>;
        };

        /* Let Caps Word continue when typing Underscore */
        caps_word {
            continue-list = <UNDERSCORE MINUS BACKSPACE DELETE>;
        };

        hm: hold_mod {
            compatible = "zmk,behavior-hold-tap";
            #binding-cells = <2>;
            flavor = "balanced";
            tapping-term-ms = <300>;
            bindings = <&mo>, <&sl>;
        };
    };
    encoder_scroll: encoder_scroll {
        compatible = "zmk,behavior-sensor-rotate-var";
        #sensor-binding-cells = <2>;
        bindings = <&msc>, <&msc>;
    };
    conditional_layers {
        compatible = "zmk,conditional-layers";
        tri_layer {
            if-layers = <NUMSYM NAVFN>;
            then-layer = <SYSTEM>;
        };
    };

#include "inc/leader_macros.h" 
#include "inc/combos.h" 
    
 // cheat-sheet for indexes
 // ┌────┬──┬──┬──┬──┬──┬──┬──┬──┬────┐
 // │0   │1 │2 │3 │4 │5 │6 │7 │8 │9   │
 // ├───┬┴─┬┴─┬┴─┬┴─┬┴┬─┴┬─┴┬─┴┬─┴┬───┤
 // │10 │11│12│13│14│ │15│16│17│18│19 │
 // ├──┬┴─┬┴─┬┴─┬┴─┬┘ └┬─┴┬─┴┬─┴┬─┴┬──┤
 // │20│21│22│23│24│enc│25│26│27│28│29│
 // └──┴──┴─┬┴──┴──┼───┼──┴──┴┬─┴──┴──┘
 //         │30    │31 │32    │
 //         └──────┴───┴──────┘
/*
 * combos (see inc/combos.h for implementation)
 * ┌──────────┬─────┬─────┬─────┬─────┬─────┬─────┬─────┬─────┬─────────┐
 * │          │ +=Del=+=SftTab+ │     │     │     │ +=Del=+   │         │
 * │          │     │     │     │     │     │     │     │     │         │
 * ├─────────┬┴────┬┴────┬┴────┬┴────┬┴┬────┴┬────┴┬────┴┬────┴┬────────┤
 * │         │ +=BkSp=+=Tab=+  │     │ │     │     │  +=BkSp=+ │        │
 * │         │     │     │     │     │ │     │     │     │     │        │
 * ├────────┬┴────┬┴────┬┴────┬┴────┬┘ └┬────┴┬────┴┬────┴┬────┴┬───────┤
 * │   +=CtrlX+=CtrlC+CtrlV=+ │     │enc│     │     │     │+=DelWord=+  │
 * │        │     │     │     │     │   │     │     │     │     │       │
 * └────────┴─────┴────┬┴─────┴────┬┴───┴┬────┴─────┴┬────┴─────┴───────┘
 *                     │           │  +=system==+    │
 *                     │           │     │           │
 *                     └───────────┴─────┴───────────┘
 */
    keymap {
        compatible = "zmk,keymap";
/*
 * ┌──────────┬─────┬─────┬─────┬─────┬─────┬─────┬─────┬─────┬─────────┐
 * │q         │w    │f    │p    │b    │j    │l    │u    │y    │- _      │
 * │          │     │     │     │     │     │     │     │     │         │
 * ├─────────┬┴────┬┴────┬┴────┬┴────┬┴┬────┴┬────┴┬────┴┬────┴┬────────┤
 * │a        │r    │s    │t    │g    │ │m    │n    │e    │i    │o       │
 * │         │     │     │     │     │ │     │     │     │     │        │
 * ├────────┬┴────┬┴────┬┴────┬┴────┬┘ └┬────┴┬────┴┬────┴┬────┴┬───────┤
 * │z       │x    │c    │d    │v    │   │k    │h    │, ?  │. !  │' "    │
 * │lgui    │lalt │lctl │lshft│     │enc│     │rshft│rctl │ralt │rgui   │
 * └────────┴─────┴────┬┴─────┴────┬┴───┴┬────┴─────┴┬────┴─────┴───────┘
 *                     │space      │lead │cmd        │
 *                     │shift      │numsy│navfn      │
 *                     └───────────┴─────┴───────────┘
 */
        default_layer {
            bindings = <
            &kp Q      &kp W      &kp F      &kp P       &kp B           &kp J &kp L       &kp U               &kp Y             &kp MINUS
            &kp A      &kp R      &kp S      &kp T       &kp G           &kp M &kp N       &kp E               &kp I             &kp O
            &ht LGUI Z &ht LALT X &ht LCTL C &ht LSHFT D &kp V           &kp K &ht RSHFT H &comma_morph RCTL 0 &dot_morph RALT 0 &apos_morph RGUI 0
                                           &mt LSHFT SPACE &hm NUMSYM MC_ONESHOT &hm NAVFN CMD
            >;
            sensor-bindings = <&encoder_scroll SCRL_DOWN SCRL_UP>;
        };

/*
 * ┌──────────┬─────┬─────┬─────┬─────┬─────┬─────┬─────┬─────┬─────────┐
 * │1         │2    │3    │4    │5    │6    │7    │8    │9    │0        │
 * │          │     │     │     │     │     │     │     │     │         │
 * ├─────────┬┴────┬┴────┬┴────┬┴────┬┴┬────┴┬────┴┬────┴┬────┴┬────────┤
 * │~        │@    │= \  │* |  │+ /  │ │:    │(    │[    │{    │<       │
 * │         │     │     │     │     │ │     │     │     │     │        │
 * ├────────┬┴────┬┴────┬┴────┬┴────┬┘ └┬────┴┬────┴┬────┴┬────┴┬───────┤
 * │$       │%    │^    │#    │&    │   │;    │)    │] ,  │} .  │>      │
 * │        │     │     │     │     │enc│     │     │     │     │       │
 * └────────┴─────┴────┬┴─────┴────┬┴───┴┬────┴─────┴┬────┴─────┴───────┘
 *                     │space      │lead │cmd        │
 *                     │shift      │numsy│navfn      │
 *                     └───────────┴─────┴───────────┘
 */
        numsym_layer {
            bindings = <
            &kp N1     &kp N2    &kp N3    &kp N4     &kp N5          &kp N6    &kp N7   &kp N8   &kp N9   &kp N0
            &mc_tilde  &kp AT    &eql_bksl &star_pipe &plus_slsh      &kp COLON &kp LPAR &kp LBKT &kp LBRC &kp LS(COMMA)      
            &kp DOLLAR &kp PRCNT &mc_caret &kp HASH   &kp AMPS        &kp SEMI  &kp RPAR &kp RBKT &kp RBRC &kp LS(DOT)      
                                           &mt LSHFT SPACE &hm NUMSYM MC_ONESHOT &hm NAVFN CMD  
            >;
            sensor-bindings = <&encoder_scroll SCRL_DOWN SCRL_UP>;
        };

/*
 * ┌──────────┬─────┬─────┬─────┬─────┬─────┬─────┬─────┬─────┬─────────┐
 * │F1        │F2   │F3   │F4   │F5   │Top  │PgUp │↑    │PgDwn│Bottm    │
 * │          │     │     │     │     │     │     │     │     │         │
 * ├─────────┬┴────┬┴────┬┴────┬┴────┬┴┬────┴┬────┴┬────┴┬────┴┬────────┤
 * │F6       │F7   │F8   │F9   │F10  │ │Home │←    │↓    │→    │End     │
 * │         │     │     │     │     │ │     │     │     │     │        │
 * ├────────┬┴────┬┴────┬┴────┬┴────┬┘ └┬────┴┬────┴┬────┴┬────┴┬───────┤
 * │F11     │F12  │CtrlC│CtrlX│CtrlV│   │SelWL│WrdLf│SelLn│WrdRg│SelWR  │
 * │        │     │     │     │     │enc│     │     │     │     │       │
 * └────────┴─────┴────┬┴─────┴────┬┴───┴┬────┴─────┴┬────┴─────┴───────┘
 *                     │space      │lead │cmd        │
 *                     │shift      │numsy│navfn      │
 *                     └───────────┴─────┴───────────┘
 */
        navfn_layer {
            bindings = <
            &kp F1  &kp F2  &kp F3    &kp F4    &kp F5          &kp LC(HOME)     &kp PG_UP    &kp UP       &kp PG_DN     &kp LC(END)
            &kp F6  &kp F7  &kp F8    &kp F9    &kp F10         &kp HOME         &kp LEFT     &kp DOWN     &kp RIGHT     &kp END        
            &kp F11 &kp F12 &kp LC(C) &kp LC(X) &kp LC(V)       &kp LS(LC(LEFT)) &kp LC(LEFT) &kp LS(DOWN) &kp LC(RIGHT) &kp LS(LC(RIGHT))   
                                     &mt LSHFT SPACE &hm NUMSYM MC_ONESHOT &hm NAVFN CMD
            >;
            sensor-bindings = <&encoder_scroll SCRL_DOWN SCRL_UP>;
        };

/*
 * ┌──────────┬─────┬─────┬─────┬─────┬─────┬─────┬─────┬─────┬─────────┐
 * │Boot      │track│play │track│vol  │     │     │     │     │         │
 * │          │prev │pause│next │up   │     │     │     │     │         │
 * ├─────────┬┴────┬┴────┬┴────┬┴────┬┴┬────┴┬────┴┬────┴┬────┴┬────────┤
 * │RGB      │RGB  │stop │RGB  │vol  │ │     │     │     │     │        │
 * │Sat+     │Lum+ │     │Hue+ │down │ │     │     │     │     │        │
 * ├────────┬┴────┬┴────┬┴────┬┴────┬┘ └┬────┴┬────┴┬────┴┬────┴┬───────┤
 * │RGB     │RGB  │RGB  │RGB  │vol  │   │     │     │     │     │       │
 * │Sat-    │Lum- │Mode │Hue- │mute │enc│     │     │     │     │       │
 * └────────┴─────┴────┬┴─────┴────┬┴───┴┬────┴─────┴┬────┴─────┴───────┘
 *                     │           │     │           │
 *                     │           │     │           │
 *                     └───────────┴─────┴───────────┘
 */
        system_layer {
            bindings = <
            &bootloader   &kp C_PREV &kp C_PP   &kp C_NEXT   &kp C_VOL_UP ___ ___ ___ ___ &bootloader
            &bt BT_DISC 0 &bt BT_CLR &kp C_STOP &bt BT_SEL 0 &kp C_VOL_DN ___ ___ ___ ___ ___       
            &bt BT_DISC 1 ___        ___        &bt BT_SEL 1 &kp C_MUTE   ___ ___ ___ ___ ___       
            ___           ___        ___
            >;
            sensor-bindings = <&encoder_scroll SCRL_DOWN SCRL_UP>;
        };

/*
 * ┌──────────┬─────┬─────┬─────┬─────┬─────┬─────┬─────┬─────┬─────────┐
 * │          │Esc  │Ctrl │     │     │     │Sft+ │ü    │     │         │
 * │          │     │Sft F│     │     │     │Retrn│     │     │         │
 * ├─────────┬┴────┬┴────┬┴────┬┴────┬┴┬────┴┬────┴┬────┴┬────┴┬────────┤
 * │ä        │     │ß    │     │     │ │     │Retrn│€    │     │ö       │
 * │         │     │     │     │     │ │     │     │     │     │        │
 * ├────────┬┴────┬┴────┬┴────┬┴────┬┘ └┬────┴┬────┴┬────┴┬────┴┬───────┤
 * │        │     │     │     │     │   │     │     │     │     │       │
 * │        │     │     │     │     │enc│     │     │     │     │       │
 * └────────┴─────┴────┬┴─────┴────┬┴───┴┬────┴─────┴┬────┴─────┴───────┘
 *                     │           │     │           │
 *                     │           │     │           │
 *                     └───────────┴─────┴───────────┘
 */
        cmd_layer {
            bindings = <
            ___       &kp ESC   &kp LS(LC(F)) ___ ___ ___ &kp LS(RET) &kp RA(Y)      ___ ___
            &kp RA(Q) ___       &kp RA(S)     ___ ___ ___ &kp RET     &kp LA(LC(N5)) ___ &kp RA(P)
            ___       ___       ___           ___ ___ ___ ___         ___            ___ ___
            ___       ___       ___
            >;
            sensor-bindings = <&encoder_scroll SCRL_DOWN SCRL_UP>;
        };

        mc_oneshot {
            bindings = <
            &u_q  &kp ESC &u_f  toP   &u_b    &u_j  &u_l  &u_u  ___   ___
            &u_a  &u_r    toS   toT   ___     toM   toN   toE   &u_i  &u_o
            &u_z  toX     &u_c  &u_d  &u_v    &u_k  &u_h  ___   ___   &u_apo
            &u_lft  &to 0  &u_rgt


//            ___   ___   ___   toP   ___      ___   ___   ___   ___   ___   
//            ___   ___   toS   toT   ___      toM   toN   toE   ___   ___   
//            ___   toX   ___   ___   ___      ___   ___   ___   ___   ___   

            >;
        };

        // Mongo commands (f,l,a,r,t,n,e,o,c + self-reference m)
        mc_m {
            bindings = <
            ___   ___   &u_mf ___   ___      ___   &u_ml ___   ___   ___   
            &u_ma &u_mr ___   &u_mt ___      ___   &u_mn &u_me ___   &u_mo
            ___   ___   &u_mc ___   ___      ___   ___   ___   ___   ___   
            ___   &to 0 ___
            >;
        };

        // Status messages (w,f,b,l,u,a,m + self-reference s)
        mc_s {
            bindings = <
            ___   &u_sw &u_sf ___   &u_sb    ___   &u_sl &u_su ___   ___   
            &u_sa ___   ___   ___   ___      &u_sm ___   ___   ___   ___   
            ___   ___   ___   ___   ___      ___   ___   ___   ___   ___   
            ___   &to 0 ___
            >;
        };

        // Namen (f,p,b,j,r,s,c,d,k + self-reference n)
        mc_n {
            bindings = <
            ___   ___   &u_nf &u_np &u_nb    &u_nj ___   ___   ___   ___   
            ___   &u_nr &u_ns ___   ___      ___   ___   ___   ___   ___   
            ___   ___   &u_nc &u_nd ___      &u_nk ___   ___   ___   ___   
            ___   &to 0 ___
            >;
        };

        // Text-Snippets (p,l,a,s,m,e,z,c,d,k + self-reference t)
        mc_t {
            bindings = <
            ___   ___   ___   &u_tp ___      ___   &u_tl ___   ___   ___   
            &u_ta ___   &u_ts ___   ___      &u_tm ___   &u_te ___   ___   
            &u_tz ___   &u_tc &u_td ___      &u_tk ___   ___   ___   ___   
            ___   &to 0 ___
            >;
        };

        // Emojis (w,f,p,y,r,s,t,m,o,c,d,v,k,h + self-reference e)
        mc_e {
            bindings = <
            ___   &u_ew &u_ef &u_ep ___      ___   ___   ___   &u_ey ___   
            ___   &u_er &u_es &u_et ___      &u_em ___   ___   ___   &u_eo   
            ___   ___   &u_ec &u_ed &u_ev    &u_ek &u_eh ___   ___   ___   
            ___   &to 0 ___
            >;
        };

        // Code-Snippets (w,l,e,i,d + self-reference p)
        mc_p {
            bindings = <
            ___   &u_pw ___   ___   ___      ___   &u_pl ___   ___   ___   
            ___   ___   ___   ___   ___      ___   ___   &u_pe &u_pi ___   
            ___   ___   ___   &u_pd ___      ___   ___   ___   ___   ___   
            ___   &to 0 ___
            >;
        };

        // Programme starten (w,f,p,a,m,n,e,o + self-reference x)
        mc_x {
            bindings = <
            ___   &u_xw &u_xf &u_xp ___      ___   ___   ___   ___   ___   
            &u_xa ___   ___   ___   ___      &u_xm &u_xn &u_xe ___   &u_xo
            ___   &u_xx &u_xc ___   ___      ___   ___   ___   ___   ___   
            ___   &to 0 ___
            >;
        };
    };
/*
 * leader one-key (see inc/leader_macros.h for implementation)
 * ┌──────────┬─────┬─────┬─────┬─────┬─────┬─────┬─────┬─────┬─────────┐
 * │Lock      │     │Doubl│Comnt│Multi│MltCm│Multi│Dupli│     │         │
 * │          │     │Shift│     │Comnt│InteJ│Code │Line │     │         │
 * ├─────────┬┴────┬┴────┬┴────┬┴────┬┴┬────┴┬────┴┬────┴┬────┴┬────────┤
 * │->       │WinR │PrtSc│Mute/│     │ │- [ ]│()   │[]   │{}   │´´      │
 * │         │     │     │Unmte│     │ │     │     │     │     │        │
 * ├────────┬┴────┬┴────┬┴────┬┴────┬┘ └┬────┴┬────┴┬────┴┬────┴┬───────┤
 * │CtrlZ   │CtrlY│CtrlC│CtrlX│CtrlV│   │Alt  │Shift│     │     │""     │
 * │        │     │     │     │     │enc│CtrlV│CtrlV│     │     │       │
 * └────────┴─────┴────┬┴─────┴────┬┴───┴┬────┴─────┴┬────┴─────┴───────┘
 *                     │WinLf      │/lead│WinRg      │
 *                     │           │     │           │
 *                     └───────────┴─────┴───────────┘
 */
};
