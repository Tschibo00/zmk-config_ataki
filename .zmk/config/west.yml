## config/Kconfig.defconfig
```kconfig
if SHIELD_ATAKI

config ZMK_KEYBOARD_NAME
    default "AtaKi"

endif

if SHIELD_ATAKI_KATANA

config ZMK_KEYBOARD_NAME
    default "AtaKi_Katana"

endif
```

## config/Kconfig.shield
```kconfig
config SHIELD_ATAKI
    def_bool $(shields_list_contains,ataki)
config SHIELD_ATAKI_KATANA
    def_bool $(shields_list_contains,ataki_katakana)
```

## config/boards/shields/ataki_katana/Kconfig.defconfig
```kconfig
if SHIELD_ATAKI_KATANA

config ZMK_KEYBOARD_NAME
    default "AtaKi_Katana"

endif
```
